/*
 * nice!view on the Aurora's 4-pin OLED header.
 * nice_view_adapter defaults CS to D1 (P0.06), but the Aurora uses P0.06 as
 * the WS2812 data line. CS is bodged to P0.08 (pro_micro 0, "008") instead,
 * which is free on a wireless build (wired-split serial pin).
 */
&nice_view_spi {
    cs-gpios = <&pro_micro 0 GPIO_ACTIVE_HIGH>;
};

/* 34 LEDs per half: 5 underglow + 29 per-key, one chain */
&led_strip {
    chain-length = <34>;
};
